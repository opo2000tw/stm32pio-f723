# file: platformio.ioc
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PD7.Mode=NorPsramChipSelect1_1
PD12.GPIO_Label=PSRAM_A17
SH.FMC_A0.0=FMC_A0,18b-a1
PH15.GPIO_Label=PMOD_SEL_0
SH.FMC_A0.1=FMC_A0,A0_2
Dma.SPI1_TX.1.FIFOMode=DMA_FIFOMODE_DISABLE
PG8.Signal=GPIO_Output
FREERTOS.Events01=ThermalEvent,Dynamic,NULL;Thermal1sEvent,Dynamic,NULL
PG0.Signal=FMC_A10
SH.FMC_D5_DA5.1=FMC_D5,16b-d2
SH.FMC_D5_DA5.0=FMC_D5,16b-d1
SH.FMC_NWE.1=FMC_NWE,Lcd2
SH.FMC_NWE.0=FMC_NWE,Psram1
SH.FMC_D9_DA9.0=FMC_D9,16b-d1
SH.FMC_D9_DA9.1=FMC_D9,16b-d2
FREERTOS.configENABLE_FPU=1
PG15.GPIO_Label=SAI2_INT [WM8994ECS_GPIO1]
PF7.Signal=UART7_TX
PH9.Signal=GPIO_Output
SPI1.Direction=SPI_DIRECTION_2LINES
SH.FMC_D11_DA11.0=FMC_D11,16b-d1
SH.FMC_D11_DA11.1=FMC_D11,16b-d2
I2C2.I2C_Speed_Mode=I2C_Fast_Plus
RCC.APB2TimFreq_Value=216000000
PB6.Signal=QUADSPI_BK1_NCS
PC7.Signal=USART6_RX
PD0.Signal=FMC_D2_DA2
PD8.Signal=FMC_D13_DA13
USART6.VirtualMode-Asynchronous=VM_ASYNC
PE1.Signal=FMC_NBL1
QUADSPI.FlashSize=0x1
USB_OTG_FS.phy_itface=HCD_PHY_EMBEDDED
PF1.GPIO_Label=PSRAM_A1
PI4.GPIO_Label=SAI2_MCLK_A [WM8994ECS_MCLK1]
VP_USB_HOST_VS_USB_HOST_AUDIO_HS.Mode=AUDIO_HS
PD1.GPIO_Label=LCD_PSRAM_D3
PB12.GPIO_Label=USB_OTG_HS_ID
Dma.SPI1_RX.0.PeriphInc=DMA_PINC_DISABLE
PF12.GPIO_Label=PSRAM_A6
SAI2.Instance-SAI_B_SyncSlave=SAI$Index_Block_B
SH.S_TIM12_CH1.0=TIM12_CH1,PWM Generation1 CH1
PC4.GPIO_Label=ARD_A2
Dma.SPI1_TX.1.Mode=DMA_CIRCULAR
PE9.Signal=FMC_D6_DA6
SH.FMC_A2.0=FMC_A2,18b-a1
PB14.Mode=Internal_Phy_Host
PB1.GPIO_Label=SYS_LD_USER2
SPI1.DataSize=SPI_DATASIZE_8BIT
PE4.GPIO_Label=ARD_D8_GPIO
PG4.GPIO_Label=PSRAM_A14
PC9.Mode=Single Bank 1
PA8.Signal=I2C3_SCL
SH.FMC_D1_DA1.0=FMC_D1,16b-d1
SH.FMC_D1_DA1.1=FMC_D1,16b-d2
USB_HOST1.BSP.ip=GPIO
PB9.Signal=I2C1_SDA
Mcu.Package=UFBGA176
SAI2.RealAudioFreq-SAI_A_MasterWithClock=187.5 KHz
PB1.Signal=GPIO_Output
I2C2.I2C_Fall_Time=60
NVIC.TimeBase=TIM1_UP_TIM10_IRQn
SPI2.Mode=SPI_MODE_MASTER
PD12.Signal=FMC_A17_ALE
ADC3.Rank-0\#ChannelRegularConversion=1
NVIC.TimeBaseIP=TIM1
PA10.Signal=GPIO_Output
PE12.GPIO_Label=LCD_PSRAM_D9
PA1.PinState=GPIO_PIN_SET
PH15.PinState=GPIO_PIN_SET
RCC.APB2CLKDivider=RCC_HCLK_DIV2
PI7.Mode=SAI_A_MasterWithClock
RCC.APB1TimFreq_Value=108000000
PF10.Mode=IN8
PH8.Mode=I2C
PA4.GPIO_Label=ARD_A1
PD15.Signal=FMC_D1_DA1
Dma.SPI1_TX.1.Instance=DMA2_Stream3
PG12.Signal=GPIO_Output
PA5.Mode=Full_Duplex_Slave
TIM9.Channel-PWM\ Generation2\ CH2=TIM_CHANNEL_2
SH.FMC_A4.0=FMC_A4,18b-a1
REXTPHYHS.Signal=USB_OTG_HS_REXTPHYHS
TIM9.Channel-PWM\ Generation1\ CH1=TIM_CHANNEL_1
FREERTOS.Tasks01=defaultTask,24,128,StartDefaultTask,Default,NULL,Dynamic,NULL,NULL;myTask02,24,128,StartTask02,Default,NULL,Dynamic,NULL,NULL
PH13.Signal=UART4_TX
SH.ADCx_IN6.0=ADC1_IN6,IN6
SH.ADCx_IN6.1=ADC2_IN6,IN6
PG5.Signal=FMC_A15_BA1
SH.FMC_D10_DA10.1=FMC_D10,16b-d2
SH.FMC_D10_DA10.0=FMC_D10,16b-d1
PD3.Signal=GPIO_Output
VP_USB_HOST_VS_USB_HOST_MSC_FS.Mode=MSC_FS
PG9.Mode=NorPsramChipSelect2_2
PC2.Signal=SPI2_MISO
ADC2.SamplingTime-25\#ChannelRegularConversion=ADC_SAMPLETIME_3CYCLES
PC14-OSC32_IN.Signal=RCC_OSC32_IN
PF8.GPIO_Label=PMOD_UART7_RTS
PA0-WKUP.Mode=SYS_WakeUp0
PD10.Signal=FMC_D15_DA15
PA3.Mode=Asynchronous
PB8.GPIO_Label=SAI2_I2C1_SCL [WM8994ECS/R_SCLK]
PA8.GPIO_Label=CTP_SCL
CORTEX_M7.ART_ACCLERATOR_ENABLE=1
PE8.GPIO_Label=LCD_PSRAM_D5
PH11.GPIO_Label=LCD_BL [STLD40DPUR_EN]
PI6.Mode=SAI_A_MasterWithClock
PB14.Signal=USB_OTG_HS_DM
PA5.Signal=SPI1_SCK
FREERTOS.configUSE_POSIX_ERRNO=1
PC12.Mode=Asynchronous
PE1.GPIO_Label=PSRAM_NBL1 [IS66WV51216EBLL_UB]
PI7.Signal=SAI2_FS_A
SH.FMC_A6.0=FMC_A6,18b-a1
PE14.Signal=FMC_D11_DA11
SPI1.CRCCalculation=SPI_CRCCALCULATION_DISABLE
PB4.GPIO_Label=ARD_D12_SPI1_MISO
SPI1.Mode=SPI_MODE_SLAVE
PI2.Signal=GPIO_Output
SH.ADCx_IN4.1=ADC2_IN4,IN4
PF4.GPIO_Label=PSRAM_A4
PA1.GPIO_Label=SPI1_NSS_SOFT
SH.S_TIM9_CH1.0=TIM9_CH1,PWM Generation1 CH1
SH.ADCx_IN4.0=ADC1_IN4,IN4
QUADSPI.FifoThreshold=16
PF13.Signal=FMC_A7
PC7.GPIO_Label=VCP_RX [STM32F103CBT6_PA2]
ADC1.master=1
SAI2.Instance-SAI_A_MasterWithClock=SAI$Index_Block_A
PA5.GPIO_Label=ARD_D13_SPI1_SCK
ADC2.NbrOfConversionFlag=1
PB5.GPIO_PuPd=GPIO_PULLDOWN
PE5.GPIO_Label=ARD_D3_TIM9_CH1
PC12.GPIO_Label=UART_TXD_WIFI_RX
ProjectManager.HeapSize=0x200
PH6.Signal=S_TIM12_CH1
Dma.SPI1_RX.0.Priority=DMA_PRIORITY_VERY_HIGH
NVIC.PriorityGroup=NVIC_PRIORITYGROUP_4
PF0.GPIO_Label=PSRAM_A0
PE3.Signal=GPIO_Output
PF4.Signal=FMC_A4
PD2.Signal=UART5_RX
PI1.GPIO_Label=PMOD_SPI2_SCK
Mcu.Family=STM32F7
NVIC.OTG_HS_IRQn=true\:5\:0\:false\:true\:true\:4\:false\:true\:true
SPI2.VirtualNSS=VM_NSSHARD
SH.FMC_A8.0=FMC_A8,18b-a1
PH14.Signal=UART4_RX
PH10.Signal=GPIO_Input
SH.FMC_D14_DA14.0=FMC_D14,16b-d1
SH.FMC_D14_DA14.1=FMC_D14,16b-d2
PG2.Signal=FMC_A12
PE11.GPIO_Label=LCD_PSRAM_D8
PD0.GPIO_Label=LCD_PSRAM_D2
PA11.Mode=Host_Only
SH.FMC_A14_BA0.0=FMC_A14,18b-a1
SH.FMC_A11.0=FMC_A11,18b-a1
PG5.GPIO_Label=PSRAM_A15
PB13.GPIO_Label=USB_OTG_HS_VBUS
PI5.Mode=SAI_A_MasterWithClock
PB15.Signal=USB_OTG_HS_DP
ADC3.Channel-0\#ChannelRegularConversion=ADC_CHANNEL_8
FMC.WriteOperation1=FMC_WRITE_OPERATION_ENABLE
PG15.Signal=GPXTI15
PD13.Signal=QUADSPI_BK1_IO3
USB_HOST1.BSP.api=Unknown
SH.FMC_NBL1.0=FMC_NBL1,2ByteEnable1
USB_HOST0.BSP.ip=GPIO
I2C3.Speed=400
ADC1.Channel-0\#ChannelRegularConversion=ADC_CHANNEL_4
RCC.HSE_VALUE=25000000
PF9.Mode=CTS_RTS
USART6.OverSampling=UART_OVERSAMPLING_16
PC14-OSC32_IN.Mode=LSE-External-Oscillator
PA14.Mode=Serial_Wire
PH7.GPIO_Label=LCD_RST
PF11.Signal=GPIO_Input
PC11.GPIO_Label=STMOD_UART4_RXD_s
PB5.Mode=Full_Duplex_Slave
PB7.Signal=FMC_NL
PB7.GPIO_Label=NC1
PH1-OSC_OUT.Mode=HSE-External-Oscillator
PD13.GPIO_Label=QSPI_D3 [MX25L51245G_SIO3]
PA6.Signal=ADCx_IN6
SH.FMC_A13.0=FMC_A13,18b-a1
REXTPHYHS.GPIO_Label=REXT_OTGPHY
PD5.GPIO_Label=LCD_PSRAM_NWE
NVIC.OTG_FS_IRQn=true\:5\:0\:false\:true\:true\:3\:false\:true\:true
PA15.Signal=SPI1_NSS
PF8.Signal=UART7_RTS
PG0.GPIO_Label=PSRAM_A10
PI0.GPIO_Label=PMOD_SPI2_NSS
PI1.Mode=Full_Duplex_Master
USB_HOST0.BSP.name=Drive_VBUS_FS
I2C3.Timing=0x6000030D
PB5.GPIO_Label=ARD_D11_TIM3_CH2_SPI1_MOSI
Dma.Request1=SPI1_TX
FREERTOS.configUSE_TICK_HOOK=0
PD3.GPIO_Label=WIFI_CH_PD
PC5.Signal=GPIO_Output
PE7.Signal=FMC_D4_DA4
PD6.Signal=GPIO_Output
Dma.Request0=SPI1_RX
PF3.GPIO_Label=PSRAM_A3
PE2.GPIO_Label=QSPI_D2 [MX25L51245G_SIO2]
PB4.Signal=SPI1_MISO
PG2.GPIO_Label=PSRAM_A12
PA3.Signal=USART2_RX
SAI2.MClockEnable-SAI_A_MasterWithClock=SAI_MASTERCLOCK_ENABLE
Dma.SPI1_TX.1.MemInc=DMA_MINC_ENABLE
PD15.GPIO_Label=LCD_PSRAM_D1
PH12.GPIO_Label=USB_OTGHS_PPWR_EN
PC9.GPIO_Label=QSPI_D0 [MX25L51245G_SIO0]
PC11.Signal=GPIO_Output
PC8.Signal=GPXTI8
USB_HOST0.BSP.solution=PG8
PC10.Mode=Single Bank 1
PC2.Mode=Full_Duplex_Master
PE14.GPIO_Label=LCD_PSRAM_D11
PD9.Signal=FMC_D14_DA14
Dma.SPI1_TX.1.Direction=DMA_MEMORY_TO_PERIPH
SH.S_TIM3_CH3.0=TIM3_CH3,PWM Generation3 CH3
USB_HOST1.BSP.i2creg=0
USB_HOST1.BSP.STBoard=false
PD8.GPIO_Label=LCD_PSRAM_D13
PG8.GPIO_Label=USB_OTGFS_PPWR_EN
PA13.Signal=SYS_JTMS-SWDIO
Dma.SPI1_RX.0.FIFOMode=DMA_FIFOMODE_DISABLE
FREERTOS.configUSE_IDLE_HOOK=0
CORTEX_M7.MPU_Control=__NULL
PA9.Mode=Activate_VBUS
ADC3.SamplingTime-0\#ChannelRegularConversion=ADC_SAMPLETIME_3CYCLES
PF6.Signal=UART7_RX
SH.FMC_A17_ALE.0=FMC_A17,18b-a1
PB10.GPIO_Label=USB_OTGFS_OVCR_INT
FREERTOS.configUSE_TRACE_FACILITY=0
SH.FMC_A16_CLE.0=FMC_A16,18b-a1
SH.FMC_D13_DA13.0=FMC_D13,16b-d1
PH8.Signal=I2C3_SDA
SH.FMC_D13_DA13.1=FMC_D13,16b-d2
PB9.Mode=I2C
RCC.USBFreq_Value=48000000
PH13.Mode=Asynchronous
PF9.GPIO_Label=PMOD_UART7_CTS
PD10.GPIO_Label=LCD_PSRAM_D15
TIM4.Prescaler=10800-1
PA1.Signal=GPIO_Output
PD2.Mode=Asynchronous
board=STM32F723E-DISCO
RCC.VCOOutputFreq_Value=432000000
PI9.Signal=GPXTI9
PH4.GPIO_Label=ARD_D15_STMOD_I2C2_SCL
PB15.Mode=Internal_Phy_Host
TIM12.Channel-PWM\ Generation1\ CH1=TIM_CHANNEL_1
SH.ADCx_IN11.1=ADC2_IN11,IN11
SH.ADCx_IN11.0=ADC1_IN11,IN11
PI4.Signal=SAI2_MCLK_A
PA1.GPIO_Speed=GPIO_SPEED_FREQ_HIGH
Dma.SPI1_RX.0.Instance=DMA2_Stream0
PC1.GPIO_Label=ARD_A5
SH.FMC_D12_DA12.1=FMC_D12,16b-d2
SH.FMC_D12_DA12.0=FMC_D12,16b-d1
PF15.GPIO_Label=PSRAM_A9
PF1.Signal=FMC_A1
I2C2.Speed=1000
PE0.Signal=FMC_NBL0
PE7.GPIO_Label=LCD_PSRAM_D4
PE12.Signal=FMC_D9_DA9
RCC.SYSCLKFreq_VALUE=216000000
PB2.Mode=Single Bank 1
PB2.GPIO_Label=QSPI_CLK [MX25L51245G_SCLK]
RCC.HSI_VALUE=16000000
RCC.PLLQ=9
PI3.GPIO_Label=PMOD_SPI2_MOSI
PH3.Signal=GPIO_Output
RCC.PLLM=25
RCC.PLLN=432
PA2.Mode=Asynchronous
PH5.Mode=I2C
CORTEX_M7.CPU_DCache=Enabled
ADC2.Channel-25\#ChannelRegularConversion=ADC_CHANNEL_4
ADC3.NbrOfConversionFlag=1
PB12.Signal=GPIO_Output
PA3.GPIO_Label=ARD_D0_USART2_RX
USB_HOST0.BSP.instance=PG8
SH.FMC_D7_DA7.1=FMC_D7,16b-d2
SH.FMC_D7_DA7.0=FMC_D7,16b-d1
Dma.SPI1_TX.1.Priority=DMA_PRIORITY_VERY_HIGH
PH0-OSC_IN.Signal=RCC_OSC_IN
PH12.Signal=GPIO_Output
I2C1.I2C_Speed_Mode=I2C_Fast
QUADSPI.ClockPrescaler=1
SPI1.VirtualType=VM_SLAVE
SPI2.VirtualType=VM_MASTER
FREERTOS.configUSE_DAEMON_TASK_STARTUP_HOOK=1
PG4.Signal=FMC_A14_BA0
PC12.Signal=UART5_TX
PH6.GPIO_Label=ARD_D9_TIM12_CH1
CORTEX_M7.PREFETCH_ENABLE=1
PC6.GPIO_Label=VCP_TX [STM32F103CBT6_PA3]
PB6.GPIO_Label=QSPI_NCS [MX25L51245G_CS]
PI6.GPIO_Label=SAI2_SD_A [WM8994ECS_DACDAT1]
PA6.GPIO_Label=ARD_A0
PB13.Signal=GPXTI13
PG13.Signal=GPIO_Output
PD6.GPIO_Label=WIFI_GPIO_2
PE6.GPIO_Label=ARD_D6_TIM9_CH2
PF6.GPIO_Label=PMOD_UART7_RXD
RCC.SYSCLKSource=RCC_SYSCLKSOURCE_PLLCLK
ADC2.Rank-25\#ChannelRegularConversion=1
SH.FMC_A15_BA1.0=FMC_A15,18b-a1
PH5.Signal=I2C2_SDA
Dma.SPI1_RX.0.Direction=DMA_PERIPH_TO_MEMORY
PE2.Mode=Single Bank 1
PD4.Signal=FMC_NOE
PB6.Mode=Single Bank 1
PC3.Signal=SPI2_MOSI
PE5.Signal=S_TIM9_CH1
PA1.GPIO_PuPd=GPIO_PULLUP
PF10.GPIO_Label=ARD_A3_ADC3_IN8
PH10.GPIO_Label=USB_OTGHS_OVCR_INT
Dma.SPI1_TX.1.PeriphDataAlignment=DMA_PDATAALIGN_HALFWORD
PB2.Signal=QUADSPI_CLK
PI6.Signal=SAI2_SD_A
PI3.Signal=GPIO_Output
PA5.GPIO_PuPd=GPIO_PULLDOWN
SPI2.CalculateBaudRate=13.5 MBits/s
PE2.Signal=QUADSPI_BK1_IO2
PF8.Mode=CTS_RTS
USB_HOST.USBH_USE_OS-AUDIO_HS=0
SPI1.VirtualNSS=VM_NSSHARD
TIM4.Period=10000-1
PF3.Signal=FMC_A3
PE10.Signal=FMC_D7_DA7
ADC1.SamplingTime-0\#ChannelRegularConversion=ADC_SAMPLETIME_3CYCLES
SAI2.ErrorAudioFreq-SAI_A_MasterWithClock=-2.34 %
SH.ADCx_IN14.1=ADC2_IN14,IN14
SH.ADCx_IN14.0=ADC1_IN14,IN14
I2C2.I2C_Rise_Time=60
SH.FMC_A1.0=FMC_A1,18b-a1
PH2.Signal=GPIO_Output
PF14.Signal=FMC_A8
PE10.GPIO_Label=LCD_PSRAM_D7
SH.FMC_D3_DA3.0=FMC_D3,16b-d1
SH.FMC_D3_DA3.1=FMC_D3,16b-d2
PH15.Signal=GPIO_Output
ADC1.Rank-0\#ChannelRegularConversion=1
PD9.GPIO_Label=LCD_PSRAM_D14
PI4.Mode=SAI_A_MasterWithClock
PG9.Signal=FMC_NE2
FREERTOS.configCHECK_FOR_STACK_OVERFLOW=0
PC6.Signal=USART6_TX
PB11.GPIO_Label=PMOD_INT
PD7.Signal=FMC_NE1
PD1.Signal=FMC_D3_DA3
PF14.GPIO_Label=PSRAM_A8
PC0.Signal=ADCx_IN10
RCC.APB1CLKDivider=RCC_HCLK_DIV4
SH.FMC_NOE.0=FMC_NOE,Psram1
SH.FMC_NOE.1=FMC_NOE,Lcd2
PF13.GPIO_Label=PSRAM_A7
PG13.GPIO_Label=WIFI_GPIO_0
USB_HOST.USBH_HandleTypeDef-MSC_FS=hUsbHostFS
PA0-WKUP.GPIO_Label=SYS_B_User
PG10.Signal=SAI2_SD_B
PA0-WKUP.Signal=SYS_WKUP1
USB_HOST0.BSP.STBoard=false
TIM3.Channel-PWM\ Generation3\ CH3=TIM_CHANNEL_3
SH.FMC_A3.0=FMC_A3,18b-a1
Dma.SPI1_TX.1.MemDataAlignment=DMA_MDATAALIGN_HALFWORD
SH.S_TIM9_CH2.0=TIM9_CH2,PWM Generation2 CH2
SH.FMC_D15_DA15.1=FMC_D15,16b-d2
SH.FMC_D15_DA15.0=FMC_D15,16b-d1
PC6.Mode=Asynchronous
USB_HOST.VirtualModeHS=Audio
PA9.Signal=USB_OTG_FS_VBUS
I2C1.Timing=0x6000030D
SAI2.VirtualMode-SAI_B_SyncSlave=VM_SLAVE
PB4.GPIO_PuPd=GPIO_PULLDOWN
PE9.GPIO_Label=LCD_PSRAM_D6
PB10.Signal=GPXTI10
PH9.GPIO_Label=CTP_RST
PI9.GPIO_Label=CTP_INT
USB_HOST.VirtualModeFS=Msc
PH14.Mode=Asynchronous
PE15.Signal=FMC_D12_DA12
PE8.Signal=FMC_D5_DA5
PI1.Signal=SPI2_SCK
Dma.SPI1_RX.0.PeriphDataAlignment=DMA_PDATAALIGN_HALFWORD
FREERTOS.INCLUDE_xEventGroupSetBitFromISR=1
PG14.GPIO_Label=WIFI_RST
PA13.Mode=Serial_Wire
PH4.Mode=I2C
PH14.GPIO_Label=STMOD_UART4_RXD
TIM5.Channel-PWM\ Generation2\ CH2=TIM_CHANNEL_2
USB_HOST1.BSP.i2caddr=0
PA4.Signal=ADCx_IN4
PB5.Signal=SPI1_MOSI
PE13.GPIO_Label=LCD_PSRAM_D10
PD11.Signal=FMC_A16_CLE
SH.FMC_A5.0=FMC_A5,18b-a1
PA11.Signal=USB_OTG_FS_DM
PF6.Mode=Asynchronous
NVIC.TIM1_UP_TIM10_IRQn=true\:0\:0\:false\:false\:true\:false\:true\:true
PF9.Signal=UART7_CTS
FREERTOS.Timers01=myTimer01,Callback01,osTimerPeriodic,Default,NULL,Dynamic,NULL;myTimer02,Callback02,osTimerPeriodic,Default,NULL,Dynamic,NULL
VP_TIM4_VS_ClockSourceINT.Mode=Internal
PB8.Mode=I2C
PC3.GPIO_Label=STMOD+_SPI2_MOSIs
PA8.Mode=I2C
PG3.GPIO_Label=PSRAM_A13
PB0.Signal=S_TIM3_CH3
USB_HOST0.BSP.mode=Output
PC1.Signal=ADCx_IN11
PG10.GPIO_Label=SAI2_SD_B [SAI2_SD_B_ADCDAT1]
PD2.GPIO_Label=UART_RXD_WIFI_TX
PH2.GPIO_Label=PMOD_GPIO_1
I2C3.I2C_Speed_Mode=I2C_Fast
PC3.Mode=Full_Duplex_Master
RCC.CortexFreq_Value=216000000
PC10.Signal=QUADSPI_BK1_IO1
I2C2.Timing=0x00500B19
SH.FMC_NBL0.0=FMC_NBL0,2ByteEnable1
SH.S_TIM5_CH2.0=TIM5_CH2,PWM Generation2 CH2
SH.FMC_D6_DA6.1=FMC_D6,16b-d2
Dma.SPI1_TX.1.PeriphInc=DMA_PINC_DISABLE
PC0.GPIO_Label=ARD_A4
SH.FMC_D6_DA6.0=FMC_D6,16b-d1
PB0.GPIO_Label=ARD_D5_STMOD_TIM3_CH3
PH5.GPIO_Label=ARD_D14_STMOD_I2C2_SDA
PI5.GPIO_Label=SAI2_SCK_A [WM8994ECS_BCLK1]
PB11.Signal=GPXTI11
ProjectManager.StackSize=0x400
VP_FREERTOS_VS_CMSIS_V2.Mode=CMSIS_V2
USB_HOST.USBH_HandleTypeDef-AUDIO_HS=hUsbHostHS
SH.FMC_A7.0=FMC_A7,18b-a1
PA12.Signal=USB_OTG_FS_DP
PD11.GPIO_Label=PSRAM_A16
RCC.HCLKFreq_Value=216000000
PF11.GPIO_Label=PMOD_RESET
PF12.Signal=FMC_A6
FREERTOS.configUSE_MALLOC_FAILED_HOOK=1
NVIC.DMA2_Stream0_IRQn=true\:5\:0\:false\:true\:true\:1\:true\:false\:true
SH.FMC_A10.0=FMC_A10,18b-a1
RCC.AHBFreq_Value=216000000
SPI2.BaudRatePrescaler=SPI_BAUDRATEPRESCALER_4
PH0-OSC_IN.Mode=HSE-External-Oscillator
USB_HOST1.BSP.instance=PH12
SH.FMC_D8_DA8.0=FMC_D8,16b-d1
SH.FMC_D8_DA8.1=FMC_D8,16b-d2
USART2.VirtualMode-Asynchronous=VM_ASYNC
PA15.Mode=NSS_Signal_Hard_Input
SH.FMC_D2_DA2.0=FMC_D2,16b-d1
SH.FMC_D2_DA2.1=FMC_D2,16b-d2
PB4.Mode=Full_Duplex_Slave
PE13.Signal=FMC_D10_DA10
PF7.GPIO_Label=PMOD_UART7_TXD
PI5.Signal=SAI2_SCK_A
VP_SYS_VS_tim1.Mode=TIM1
PI0.Signal=SPI2_NSS
PA10.GPIO_Label=USB_OTG_FS_ID
SAI2.VirtualMode-SAI_A_MasterWithClock=VM_MASTER
USB_HOST0.BSP.i2creg=0
PE4.Signal=GPIO_Output
PD7.GPIO_Label=PSRAM_NE1 [IS66WV51216EBLL_CS1]
USB_HOST0.BSP.i2caddr=0
FREERTOS.INCLUDE_xTaskAbortDelay=1
SH.FMC_D0_DA0.0=FMC_D0,16b-d1
SH.FMC_D0_DA0.1=FMC_D0,16b-d2
PA2.GPIO_Label=ARD_D1_USART2_TX
PF5.GPIO_Label=PSRAM_A5
USB_OTG_FS.VirtualMode=Host_Only
SH.FMC_A9.0=FMC_A9,18b-a1
SH.FMC_D4_DA4.1=FMC_D4,16b-d2
USART6.BaudRate=1843200
SH.FMC_D4_DA4.0=FMC_D4,16b-d1
PE0.GPIO_Label=PSRAM_NBL0 [IS66WV51216EBLL_LB]
ADC3.ClockPrescaler=ADC_CLOCK_SYNC_PCLK_DIV4
PH3.GPIO_Label=ARD_D4_GPIO
PF5.Signal=FMC_A5
PH7.Signal=GPIO_Output
SH.FMC_NL.0=FMC_NL,AddressValid1
SPI2.Direction=SPI_DIRECTION_2LINES
PF0.Signal=FMC_A0
PI2.GPIO_Label=PMOD_SPI2_MISO
PC2.GPIO_Label=STMOD_SPI2_MISOs
REXTPHYHS.Mode=Internal_Phy_Host
SH.FMC_A12.0=FMC_A12,18b-a1
PB3.GPIO_Label=SYS_STLINK_JTDO_SWO
ADC2.ClockPrescaler=ADC_CLOCK_SYNC_PCLK_DIV4
PC15-OSC32_OUT.Mode=LSE-External-Oscillator
CORTEX_M7.CPU_ICache=Enabled
PB9.GPIO_Label=SAI2_I2C1_SDA [WM8994ECS_SDA]
PC10.GPIO_Label=QSPI_D1 [MX25L51245G_SIO1]
PH11.Signal=S_TIM5_CH2
PG3.Signal=FMC_A13
PG1.Signal=FMC_A11
PG10.Mode=SAI_B_SyncSlave
PC4.Signal=ADCx_IN14
USB_HOST.BSP.number=2
PI10.Signal=GPIO_Output
PD5.Signal=FMC_NWE
FREERTOS.CountingSemaphores01=empty_id,10,Dynamic,NULL;filled_id,10,Dynamic,NULL
Dma.SPI1_RX.0.Mode=DMA_CIRCULAR
FREERTOS.configUSE_APPLICATION_TASK_TAG=1
PH13.GPIO_Label=STMOD_UART4_TXD
PC8.GPIO_Label=LCD_TE_INT
PF7.Mode=Asynchronous
PH8.GPIO_Label=CTP_SDA
PE15.GPIO_Label=LCD_PSRAM_D12
PH4.Signal=I2C2_SCL
ProjectManager.TargetToolchain=Makefile
USB_HOST1.BSP.mode=Output
PI0.Mode=NSS_Signal_Hard_Output
PD13.Mode=Single Bank 1
PF2.Signal=FMC_A2
NVIC.DMA2_Stream3_IRQn=true\:5\:0\:false\:true\:true\:2\:true\:false\:true
PE11.Signal=FMC_D8_DA8
CORTEX_M7.FlashInterface=AXI_Enabled
PC15-OSC32_OUT.Signal=RCC_OSC32_OUT
PG9.GPIO_Label=LCD_NE
PG14.Signal=GPIO_Output
PG1.GPIO_Label=PSRAM_A11
RCC.APB2Freq_Value=108000000
USB_HOST0.BSP.api=Unknown
PD4.GPIO_Label=LCD_PSRAM_NWE
PF10.Signal=ADC3_IN8
PH1-OSC_OUT.Signal=RCC_OSC_OUT
PI7.GPIO_Label=SAI2_FS_A [WM8994ECS_LRCLK1]
Dma.SPI1_RX.0.MemDataAlignment=DMA_MDATAALIGN_HALFWORD
PF15.Signal=FMC_A9
PD14.GPIO_Label=LCD_PSRAM_D0
USB_HOST1.BSP.solution=PH12
PE6.Signal=S_TIM9_CH2
Mcu.Name=STM32F723I(C-E)Kx
FREERTOS.INCLUDE_xSemaphoreGetMutexHolder=1
USB_HOST1.BSP.name=Drive_VBUS_HS
Dma.SPI1_RX.0.MemInc=DMA_MINC_ENABLE
PA2.Signal=USART2_TX
PD14.Signal=FMC_D0_DA0
PB3.Signal=SYS_JTDO-SWO
PA7.GPIO_Label=SYS_LD_USER1
PA12.Mode=Host_Only
USB_OTG_HS.VirtualMode=Int_Phy_Host
PC5.GPIO_Label=ARD_D2_GPIO
PA14.Signal=SYS_JTCK-SWCLK
SH.ADCx_IN10.1=ADC2_IN10,IN10
SH.ADCx_IN10.0=ADC1_IN10,IN10
PG12.GPIO_Label=PMOD_GPIO_0
ADC1.NbrOfConversionFlag=1
PB8.Signal=I2C1_SCL
PE3.GPIO_Label=ARD_D7_GPIO
PC9.Signal=QUADSPI_BK1_IO0
PC7.Mode=Asynchronous
RCC.APB1Freq_Value=54000000
ADC1.ClockPrescaler=ADC_CLOCK_SYNC_PCLK_DIV4
PA7.Signal=GPIO_Output
PA1.GPIO_ModeDefaultOutputPP=GPIO_MODE_OUTPUT_PP
PF2.GPIO_Label=PSRAM_A2

// file: Core/Src/main.c
/* USER CODE BEGIN Header */
/* USER CODE END Header */
#include "main.h"
#include "cmsis_os.h"
#include "adc.h"
#include "dma.h"
#include "i2c.h"
#include "quadspi.h"
#include "sai.h"
#include "spi.h"
#include "tim.h"
#include "usart.h"
#include "usb_host.h"
#include "gpio.h"
#include "fmc.h"

/* USER CODE BEGIN Includes */
#include "stm32f723e_discovery.h"
#include "stm32f723e_discovery_lcd.h"
#include "MLX90640_I2C_Driver.h"
#include "MLX90640_API.h"
#include <stdbool.h>
#include <stdio.h>
/* USER CODE END Includes */

void SystemClock_Config(void);
void MX_FREERTOS_Init(void);
static void MX_NVIC_Init(void);

int main(void)
{
  /* USER CODE BEGIN 1 */
  /* Initialize library */
  /* USER CODE END 1 */

  /* Enable I-Cache---------------------------------------------------------*/
  SCB_EnableICache();

  /* Enable D-Cache---------------------------------------------------------*/
  SCB_EnableDCache();

  /* MCU Configuration--------------------------------------------------------*/

  /* Reset of all peripherals, Initializes the Flash interface and the Systick. */
  HAL_Init();

  /* Configure the system clock */
  SystemClock_Config();

  /* Initialize all configured peripherals */
  MX_GPIO_Init();
  MX_DMA_Init();
  MX_ADC1_Init();
  MX_ADC2_Init();
  MX_ADC3_Init();
  MX_FMC_Init();
  MX_I2C1_Init();
  MX_I2C2_Init();
  MX_I2C3_Init();
  MX_QUADSPI_Init();
  MX_SAI2_Init();
  MX_SPI1_Init();
  MX_SPI2_Init();
  MX_TIM3_Init();
  MX_TIM5_Init();
  MX_TIM9_Init();
  MX_TIM12_Init();
  MX_UART4_Init();
  MX_UART5_Init();
  MX_UART7_Init();
  MX_USART2_UART_Init();
  MX_USART6_UART_Init();
  MX_TIM4_Init();

  /* Initialize interrupts */
  MX_NVIC_Init();
  /* USER CODE BEGIN 2 */
#if 0
  MPU_ConfigPSRAM();
  if (BSP_LCD_Init() != LCD_OK)
  {
    printf("BSP_LCD_Init fail");
  }
  else
  {
    printf("BSP_LCD_Init");
  }
  while (1)
  {
#if 0
    LCD_demo();
    HAL_Delay(10000);
#else
  testQQ();
#endif
  }
#endif
  HAL_Delay(200);
  if (MLX90640_I2CCheck() != true)
  {
    Error_Handler();
  }
  /* USER CODE END 2 */

  /* Init scheduler */
  osKernelInitialize();  /* Call init function for freertos objects (in freertos.c) */
  MX_FREERTOS_Init();
  /* Start scheduler */
  osKernelStart();

  /* We should never get here as control is now taken by the scheduler */
  /* Infinite loop */
  while (1)
  {

  }
}

void SystemClock_Config(void)
{
  RCC_OscInitTypeDef RCC_OscInitStruct = {0};
  RCC_ClkInitTypeDef RCC_ClkInitStruct = {0};
  RCC_PeriphCLKInitTypeDef PeriphClkInitStruct = {0};

  /** Configure LSE Drive Capability
  */
  HAL_PWR_EnableBkUpAccess();
  /** Configure the main internal regulator output voltage
  */
  __HAL_RCC_PWR_CLK_ENABLE();
  __HAL_PWR_VOLTAGESCALING_CONFIG(PWR_REGULATOR_VOLTAGE_SCALE1);
  /** Initializes the RCC Oscillators according to the specified parameters
  * in the RCC_OscInitTypeDef structure.
  */
  RCC_OscInitStruct.OscillatorType = RCC_OSCILLATORTYPE_HSE;
  RCC_OscInitStruct.HSEState = RCC_HSE_ON;
  RCC_OscInitStruct.PLL.PLLState = RCC_PLL_ON;
  RCC_OscInitStruct.PLL.PLLSource = RCC_PLLSOURCE_HSE;
  RCC_OscInitStruct.PLL.PLLM = 25;
  RCC_OscInitStruct.PLL.PLLN = 432;
  RCC_OscInitStruct.PLL.PLLP = RCC_PLLP_DIV2;
  RCC_OscInitStruct.PLL.PLLQ = 9;
  if (HAL_RCC_OscConfig(&RCC_OscInitStruct) != HAL_OK)
  {
    Error_Handler();
  }
  /** Activate the Over-Drive mode
  */
  if (HAL_PWREx_EnableOverDrive() != HAL_OK)
  {
    Error_Handler();
  }
  /** Initializes the CPU, AHB and APB buses clocks
  */
  RCC_ClkInitStruct.ClockType = RCC_CLOCKTYPE_HCLK | RCC_CLOCKTYPE_SYSCLK
                                | RCC_CLOCKTYPE_PCLK1 | RCC_CLOCKTYPE_PCLK2;
  RCC_ClkInitStruct.SYSCLKSource = RCC_SYSCLKSOURCE_PLLCLK;
  RCC_ClkInitStruct.AHBCLKDivider = RCC_SYSCLK_DIV1;
  RCC_ClkInitStruct.APB1CLKDivider = RCC_HCLK_DIV4;
  RCC_ClkInitStruct.APB2CLKDivider = RCC_HCLK_DIV2;

  if (HAL_RCC_ClockConfig(&RCC_ClkInitStruct, FLASH_LATENCY_7) != HAL_OK)
  {
    Error_Handler();
  }
  PeriphClkInitStruct.PeriphClockSelection = RCC_PERIPHCLK_USART2 | RCC_PERIPHCLK_USART6
      | RCC_PERIPHCLK_UART4 | RCC_PERIPHCLK_UART5
      | RCC_PERIPHCLK_UART7 | RCC_PERIPHCLK_SAI2
      | RCC_PERIPHCLK_I2C1 | RCC_PERIPHCLK_I2C2
      | RCC_PERIPHCLK_I2C3 | RCC_PERIPHCLK_CLK48;
  PeriphClkInitStruct.PLLSAI.PLLSAIN = 192;
  PeriphClkInitStruct.PLLSAI.PLLSAIQ = 2;
  PeriphClkInitStruct.PLLSAI.PLLSAIP = RCC_PLLSAIP_DIV2;
  PeriphClkInitStruct.PLLSAIDivQ = 1;
  PeriphClkInitStruct.Sai2ClockSelection = RCC_SAI2CLKSOURCE_PLLSAI;
  PeriphClkInitStruct.Usart2ClockSelection = RCC_USART2CLKSOURCE_PCLK1;
  PeriphClkInitStruct.Uart4ClockSelection = RCC_UART4CLKSOURCE_PCLK1;
  PeriphClkInitStruct.Uart5ClockSelection = RCC_UART5CLKSOURCE_PCLK1;
  PeriphClkInitStruct.Usart6ClockSelection = RCC_USART6CLKSOURCE_PCLK2;
  PeriphClkInitStruct.Uart7ClockSelection = RCC_UART7CLKSOURCE_PCLK1;
  PeriphClkInitStruct.I2c1ClockSelection = RCC_I2C1CLKSOURCE_PCLK1;
  PeriphClkInitStruct.I2c2ClockSelection = RCC_I2C2CLKSOURCE_PCLK1;
  PeriphClkInitStruct.I2c3ClockSelection = RCC_I2C3CLKSOURCE_PCLK1;
  PeriphClkInitStruct.Clk48ClockSelection = RCC_CLK48SOURCE_PLL;
  if (HAL_RCCEx_PeriphCLKConfig(&PeriphClkInitStruct) != HAL_OK)
  {
    Error_Handler();
  }
}

/**
  * @brief NVIC Configuration.
  * @retval None
  */
static void MX_NVIC_Init(void)
{
  /* DMA2_Stream0_IRQn interrupt configuration */
  HAL_NVIC_SetPriority(DMA2_Stream0_IRQn, 5, 0);
  HAL_NVIC_EnableIRQ(DMA2_Stream0_IRQn);
  /* DMA2_Stream3_IRQn interrupt configuration */
  HAL_NVIC_SetPriority(DMA2_Stream3_IRQn, 5, 0);
  HAL_NVIC_EnableIRQ(DMA2_Stream3_IRQn);
  /* OTG_FS_IRQn interrupt configuration */
  HAL_NVIC_SetPriority(OTG_FS_IRQn, 5, 0);
  HAL_NVIC_EnableIRQ(OTG_FS_IRQn);
  /* OTG_HS_IRQn interrupt configuration */
  HAL_NVIC_SetPriority(OTG_HS_IRQn, 5, 0);
  HAL_NVIC_EnableIRQ(OTG_HS_IRQn);
}

void HAL_TIM_PeriodElapsedCallback(TIM_HandleTypeDef *htim)
{
  if (htim->Instance == TIM1)
  {
    HAL_IncTick();
  }
}

void Error_Handler(void)
{
  /* USER CODE BEGIN Error_Handler_Debug */
  __NOP(); //
  BSP_LED_Toggle(LED_RED);
  while (1)
  {
    NVIC_SystemReset();
  }
  /* USER CODE END Error_Handler_Debug */
}

#ifdef  USE_FULL_ASSERT
/**
  * @brief  Reports the name of the source file and the source line number
  *         where the assert_param error has occurred.
  * @param  file: pointer to the source file name
  * @param  line: assert_param error line source number
  * @retval None
  */
void assert_failed(uint8_t *file, uint32_t line)
{
  /* USER CODE BEGIN 6 */
  BSP_LED_Toggle(LED_RED);
  /* User can add his own implementation to report the file name and line number,
     tex: printf("Wrong parameters value: file %s on line %d\r\n", file, line) */
  printf("Wrong parameters value: file %s on line %ld\r\n", file, line);
  /* USER CODE END 6 */
}
#endif /* USE_FULL_ASSERT */

/************************ (C) COPYRIGHT STMicroelectronics *****END OF FILE****/

// file: Core/Src/freertos.c
/* USER CODE BEGIN Header */
/**
  ******************************************************************************
  * File Name          : freertos.c
  * Description        : Code for freertos applications
  ******************************************************************************
  * @attention
  *
  * <h2><center>&copy; Copyright (c) 2020 STMicroelectronics.
  * All rights reserved.</center></h2>
  *
  * This software component is licensed by ST under Ultimate Liberty license
  * SLA0044, the "License"; You may not use this file except in compliance with
  * the License. You may obtain a copy of the License at:
  *                             www.st.com/SLA0044
  *
  ******************************************************************************
  */
/* USER CODE END Header */

#include "FreeRTOS.h"
#include "task.h"
#include "main.h"
#include "cmsis_os.h"

/* USER CODE BEGIN Includes */
#include <stddef.h>
#include <stdbool.h>
#include "stm32f723e_discovery.h"
#include "MLX90640_I2C_Driver.h"
#include "MLX90640_API.h"
#include "usart.h"
#include "cpu_utils.h"
#include "spi.h"
/* USER CODE END Includes */

/* USER CODE BEGIN PTD */
static void spi_process(void);
/* USER CODE END PTD */

/* USER CODE BEGIN PM */
#define NELEMS(x)  (sizeof(x) / sizeof((x)[0]))
#define size (sizeof(float) / sizeof(uint8_t) * 768)
#define spi_evt_id 0x00000001
#define i2c_evt_id 0x00000002
#define qqq_evt_id 0x00000004
osStatus_t spi_state;
/* USER CODE END PM */

/* USER CODE BEGIN Variables */
uint16_t CPUUsage;
uint8_t *test_ptr = (uint8_t *) &mlx90640To[0];
extern struct mlx_event mlx_event;
extern volatile uint8_t time4_seconds_elapsed;

uint8_t aRxBuffer[DMA_U8_OUTPUT_SIZE]__attribute__((aligned (4))) = {0};
uint8_t aTxBuffer[DMA_U8_OUTPUT_SIZE]__attribute__((aligned (4))) = {0};
/* USER CODE END Variables */
/* Definitions for defaultTask */
osThreadId_t defaultTaskHandle;
const osThreadAttr_t defaultTask_attributes = {
  .name = "defaultTask",
  .priority = (osPriority_t) osPriorityNormal,
  .stack_size = 128 * 4
};
/* Definitions for myTask02 */
osThreadId_t myTask02Handle;
const osThreadAttr_t myTask02_attributes = {
  .name = "myTask02",
  .priority = (osPriority_t) osPriorityNormal,
  .stack_size = 128 * 4
};
/* Definitions for myTimer01 */
osTimerId_t myTimer01Handle;
const osTimerAttr_t myTimer01_attributes = {
  .name = "myTimer01"
};
/* Definitions for myTimer02 */
osTimerId_t myTimer02Handle;
const osTimerAttr_t myTimer02_attributes = {
  .name = "myTimer02"
};
/* Definitions for empty_id */
osSemaphoreId_t empty_idHandle;
const osSemaphoreAttr_t empty_id_attributes = {
  .name = "empty_id"
};
/* Definitions for filled_id */
osSemaphoreId_t filled_idHandle;
const osSemaphoreAttr_t filled_id_attributes = {
  .name = "filled_id"
};
/* Definitions for ThermalEvent */
osEventFlagsId_t ThermalEventHandle;
const osEventFlagsAttr_t ThermalEvent_attributes = {
  .name = "ThermalEvent"
};
/* Definitions for Thermal1sEvent */
osEventFlagsId_t Thermal1sEventHandle;
const osEventFlagsAttr_t Thermal1sEvent_attributes = {
  .name = "Thermal1sEvent"
};

void StartDefaultTask(void *argument);
void StartTask02(void *argument);
void Callback01(void *argument);
void Callback02(void *argument);

extern void MX_USB_HOST_Init(void);
void MX_FREERTOS_Init(void); /* (MISRA C 2004 rule 8.1) */

/* Hook prototypes */
void vApplicationMallocFailedHook(void);
void vApplicationDaemonTaskStartupHook(void);

/* USER CODE BEGIN 5 */
__weak void vApplicationMallocFailedHook(void)
{
  /* vApplicationMallocFailedHook() will only be called if
  configUSE_MALLOC_FAILED_HOOK is set to 1 in FreeRTOSConfig.h. It is a hook
  function that will get called if a call to pvPortMalloc() fails.
  pvPortMalloc() is called internally by the kernel whenever a task, queue,
  timer or semaphore is created. It is also called by various parts of the
  demo application. If heap_1.c or heap_2.c are used, then the size of the
  heap available to pvPortMalloc() is defined by configTOTAL_HEAP_SIZE in
  FreeRTOSConfig.h, and the xPortGetFreeHeapSize() API function can be used
  to query the size of free heap space that remains (although it does not
  provide information on how the remaining heap might be fragmented). */
  while (1)
    printf("[x] vApplicationMallocFailedHook\r\n");
}
/* USER CODE END 5 */

/* USER CODE BEGIN DAEMON_TASK_STARTUP_HOOK */
void vApplicationDaemonTaskStartupHook(void)
{
  printf("[x] vApplicationDaemonTaskStartupHook\r\n");
}
/* USER CODE END DAEMON_TASK_STARTUP_HOOK */

void MX_FREERTOS_Init(void) {
  /* USER CODE BEGIN Init */
  HAL_SPIEx_FlushRxFifo(TEST_SPI_ADDRESS);
  /* USER CODE END Init */

  /* Create the semaphores(s) */
  /* creation of empty_id */
  empty_idHandle = osSemaphoreNew(10, 10, &empty_id_attributes);

  /* creation of filled_id */
  filled_idHandle = osSemaphoreNew(10, 10, &filled_id_attributes);

  /* Create the timer(s) */
  /* creation of myTimer01 */
  myTimer01Handle = osTimerNew(Callback01, osTimerPeriodic, NULL, &myTimer01_attributes);

  /* creation of myTimer02 */
  myTimer02Handle = osTimerNew(Callback02, osTimerPeriodic, NULL, &myTimer02_attributes);

  /* USER CODE BEGIN RTOS_TIMERS */
  /* start timers, add new ones, ... */
  osTimerStart(myTimer01Handle, MLX_FPS_CAL(MLX_RATE));
  /* USER CODE END RTOS_TIMERS */

  /* Create the thread(s) */
  /* creation of defaultTask */
  defaultTaskHandle = osThreadNew(StartDefaultTask, NULL, &defaultTask_attributes);

  /* creation of myTask02 */
  myTask02Handle = osThreadNew(StartTask02, NULL, &myTask02_attributes);

  /* Create the event(s) */
  /* creation of ThermalEvent */
  ThermalEventHandle = osEventFlagsNew(&ThermalEvent_attributes);

  /* creation of Thermal1sEvent */
  Thermal1sEventHandle = osEventFlagsNew(&Thermal1sEvent_attributes);

}

void StartDefaultTask(void *argument)
{
  /* init code for USB_HOST */
  MX_USB_HOST_Init();
  /* USER CODE BEGIN StartDefaultTask */
  int status = MLX90640_SynchFrame(MLX_ADDR);
  if (status != 0)
  {
    printf("\r\nMLX90640_SynchFrame failed with error code:%d\r\n", status);
    Error_Handler();
  }
  // while (HAL_GPIO_ReadPin(GPIOA, GPIO_PIN_15) != GPIO_PIN_SET) // NSS signal
  // {
  //   osDelay(1);
  //   printf("Init, NSS fail\r\n");
  // }
  if (HAL_SPI_TransmitReceive_DMA(TEST_SPI_ADDRESS, test_ptr, (uint8_t *)aRxBuffer, DMA_U8_OUTPUT_SIZE) != HAL_OK)
  {
    Error_Handler();
  }
  else
  {
    printf("\r\nHAL_SPI_TransmitReceive_DMA DMA_U8_OUTPUT_SIZE=%d\r\n", DMA_U8_OUTPUT_SIZE);
  }
  /* Infinite loop */
  for (;;)
  {
    osEventFlagsWait(ThermalEventHandle, spi_evt_id | i2c_evt_id, osFlagsWaitAll, osWaitForever);
    printf("-\r\n");
    // printf("subPage:%d,vdd:%2.3f,tr:%2.3f\r\n", subPage, vdd, tr);
    // printf("slot:spi[%02d],i2c[%02d],err[%d]\r\n", mlx_event.spi, mlx_event.i2c, mlx_event.err);
    if (buffer_tag == BUFFER_A)
    {
      // printf("BUFF_A=[%2.3f],[%2.3f],[%2.3f],[%2.3f],[%2.3f]\r\n",
            //  mlx90640To[0], mlx90640To[127], mlx90640To[128], mlx90640To[256], mlx90640To[768 - 1]);
    }
  }
  /* USER CODE END StartDefaultTask */
}

void StartTask02(void *argument)
{
  /* USER CODE BEGIN StartTask02 */
  /* Infinite loop */
  for (;;)
  {
    osDelay(1000);
    // osEventFlagsWait(Thermal1sEventHandle, spi_evt_id | i2c_evt_id, osFlagsWaitAll, osWaitForever);
    printf("1s:spi[%02d],i2c[%02d]\r\n", mlx_event.spi, mlx_event.i2c);
    printf("err:fc[%d],fd[%d],init[%d],vd[%d],tr[%d]\r\n",
           mlx_event.frame_check_err, mlx_event.frame_data_err, mlx_event.init_err,
           mlx_event.vdd_err, mlx_event.tr_err);
    mlx_event.spi = 0;
    mlx_event.i2c = 0;
  }
  /* USER CODE END StartTask02 */
}

/* Callback01 function */
void Callback01(void *argument)
{
  /* USER CODE BEGIN Callback01 */
  int frame_ready_status;
  float vdd, Ta, tr;
  int subPage;
cb_01_error:
  frame_ready_status = MLX90640_GetFrameData(MLX_ADDR, frame);
  if (frame_ready_status < 0)
  {
    printf("GetFrame Error: [%d]\r\n", frame_ready_status);
    mlx_event.init_err++;
    goto cb_01_error;
  }
  else
  {
    subPage = MLX90640_GetSubPageNumber(frame);
    if (subPage >= 2 || subPage < 0)
    {
      printf("subPage Error: [%d]\r\n", subPage);
      goto cb_01_error;
    }
    // spi_state = osSemaphoreAcquire(empty_idHandle, osWaitForever);
    // if (spi_state != osOK)
    // {
    //   printf("osSemaphoreAcquire empty_idHandle 0:%d\r\n", spi_state);
    // }
    vdd = MLX90640_GetVdd(frame, &mlx90640);
    if (vdd <= 0)
    {
      mlx_event.vdd_err++;
      goto cb_01_error;
    }
    tr = MLX90640_GetTa(frame, &mlx90640) - TA_SHIFT; //Reflected temperature based on the sensor ambient temperature
    if (tr > TEMPERATURE_MAXIMUM || tr <= TEMPERATURE_MINIMUM)
    {
      mlx_event.tr_err++;
      goto cb_01_error;
    }
    if (buffer_tag == BUFFER_A)
    {
      MLX90640_CalculateTo(frame, &mlx90640, emissivity, tr, mlx90640To, buffer_tag);
    }
    // spi_state = osSemaphoreRelease(filled_idHandle);
    // if (spi_state != osOK)
    // {
    //   printf("osSemaphoreRelease filled_idHandle 0:%d\r\n", spi_state);
    // }
    mlx_event.i2c++;
    osEventFlagsSet(ThermalEventHandle, i2c_evt_id);
  }
  /* USER CODE END Callback01 */
}

/* Callback02 function */
void Callback02(void *argument)
{
  /* USER CODE BEGIN Callback02 */
  osThreadExit();
  /* USER CODE END Callback02 */
}

/* USER CODE BEGIN Application */
static void spi_process(void)
{
  uint8_t check = aRxBuffer[DMA_U8_OUTPUT_SIZE - 1];
  uint8_t type = aRxBuffer[0];
  // printf("type=0x%X,end=%X\r\n", type, check);
  // spi_state = osSemaphoreAcquire(filled_idHandle, 0);
  // if (spi_state != osOK)
  // {
  //   printf("osSemaphoreAcquire filled_idHandle 1:%d\r\n", spi_state);
  // }
  if (check == 0xFF)
  {
    mlx_event.spi++;
#if 0
    // while (HAL_GPIO_ReadPin(GPIOA, GPIO_PIN_15) != GPIO_PIN_SET) // NSS signal
    // {
    // }
    // if (HAL_SPI_TransmitReceive_DMA(TEST_SPI_ADDRESS, (uint8_t *)mlx90640To, (uint8_t *)aRxBuffer, DMA_U8_OUTPUT_SIZE) != HAL_OK)
    // {
    //   Error_Handler();
    // }
#endif
//     if (buffer_tag == BUFFER_A)
//     {
//       // printf("cb_sub=[%d],BUFF_A=[%2.3f],[%2.3f],[%2.3f],[%2.3f],[%2.3f]\r\n",
//       //        subPage, mlx90640To[0], mlx90640To[127], mlx90640To[128], mlx90640To[256], mlx90640To[768 - 1]);
//       // __NOP();
//     }
  }
  else
  {
    mlx_event.frame_check_err++;
#if DEBUG == 1
    printf("r\r\n");
    HAL_SPI_Abort_IT(TEST_SPI_ADDRESS);
#else
    Error_Handler();
#endif
  }
  // spi_state = osSemaphoreRelease(empty_idHandle);
  // if (spi_state != osOK)
  // {
  //   printf("osSemaphoreRelease empty_idHandle 1:%d\r\n", spi_state);
  // }
}
void HAL_SPI_AbortCpltCallback(SPI_HandleTypeDef *hspi)
{
  HAL_SPI_DMAStop(TEST_SPI_ADDRESS);
  HAL_SPIEx_FlushRxFifo(TEST_SPI_ADDRESS);
  __HAL_RCC_DMA2_CLK_DISABLE();
  HAL_SPI_DeInit(TEST_SPI_ADDRESS);
  __HAL_RCC_DMA2_CLK_ENABLE();
  HAL_SPI_Init(TEST_SPI_ADDRESS);
  while (HAL_GPIO_ReadPin(GPIOA, GPIO_PIN_15) != GPIO_PIN_SET) // NSS signal
  {
  }
  if (HAL_SPI_TransmitReceive_DMA(TEST_SPI_ADDRESS, test_ptr, (uint8_t *)aRxBuffer, DMA_U8_OUTPUT_SIZE) != HAL_OK)
  {
    Error_Handler();
  }
}
void HAL_SPI_RxCpltCallback(SPI_HandleTypeDef *hspi)
{
  if (hspi == TEST_SPI_ADDRESS)
  {
    printf("HAL_SPI_ErrorCallback");
    spi_process();
    BSP_LED_Toggle(LED_GREEN);
    osEventFlagsSet(ThermalEventHandle, spi_evt_id);
  }
}
void HAL_SPI_ErrorCallback(SPI_HandleTypeDef *hspi)
{
  if (hspi == TEST_SPI_ADDRESS)
  {
    printf("HAL_SPI_ErrorCallback");
    Error_Handler();
  }
}
void HAL_SPI_TxRxCpltCallback(SPI_HandleTypeDef *hspi)
{
  if (hspi == TEST_SPI_ADDRESS)
  {
    spi_process();
    BSP_LED_Toggle(LED_GREEN);
    osEventFlagsSet(ThermalEventHandle, spi_evt_id);
  }
}
void HAL_SPI_TxRxHalfCpltCallback(SPI_HandleTypeDef *hspi)
{
  // printf("rx:%d,tx:%d\r\n", __HAL_DMA_GET_COUNTER(&hdma_spi1_rx), __HAL_DMA_GET_COUNTER(&hdma_spi1_tx));
}
/* USER CODE END Application */

/************************ (C) COPYRIGHT STMicroelectronics *****END OF FILE****/
